## config/boards/arm/Bumon42/Kconfig
```kconfig
config BOARD_ENABLE_DCDC
	bool "Enable DCDC mode"
	select SOC_DCDC_NRF52X
	default y
	depends on (BOARD_BUMON42)

config BOARD_NRFMICRO_CHARGER
	bool "Enable battery charger"
	default y
	depends on (BOARD_BUMON42)
```

## config/boards/arm/Bumon42/Kconfig.defconfig
```kconfig
# Copyright (c) 2020 Stefan Sundin (4pplet)
# SPDX-License-Identifier: MIT



if BOARD_BUMON42

config BOARD
	default "Bumon42"

if USB

config USB_NRFX
	default y

config USB_DEVICE_STACK
	default y

endif # USB

config BT_CTLR
	default BT

config ZMK_BLE
	default y

config ZMK_USB
	default y

#config PINMUX
#	default y

config BOARD_NRFMICRO_CHARGER
	default y

config ZMK_BATTERY_VOLTAGE_DIVIDER
	default y

endif
```

## config/boards/arm/Lele84/Kconfig.board
```kconfig
# Copyright (c) 2020 Stefan Sundin (4pplet)
# SPDX-License-Identifier: MIT


config BOARD_BUMON42
	bool "Bumon42"
	depends on SOC_NRF52840_QIAA
```

## config/boards/shields/Bumon42/Kconfig.defconfig
```kconfig
if SHIELD_BUMON42

config ZMK_KEYBOARD_NAME
    default "⌨Bumon42"
endif

CONFIG_PINCTRL=y

CONFIG_BUILD_OUTPUT_UF2=y
CONFIG_ZMK_RGB_UNDERGLOW=y
# Use the STRIP config specific to the LEDs you're using
CONFIG_WS2812_STRIP=y
```
